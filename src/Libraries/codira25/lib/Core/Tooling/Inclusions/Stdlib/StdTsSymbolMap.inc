/*
 *
 * Copyright (c) NeXTHub Corporation. All Rights Reserved. 
 * DO NOT ALTER OR REMOVE COPYRIGHT NOTICES OR THIS FILE HEADER.
 *
 * Author: Tunjay Akbarli
 * Date: Sunday, August 7, 2022.
 *
 * Licensed under the Apache License, Version 2.0 (the ""License"");
 * you may not use this file except in compliance with the License.
 * You may obtain a copy of the License at:
 *
 *     http://www.apache.org/licenses/LICENSE-2.0
 *
 * Unless required by applicable law or agreed to in writing, software
 * distributed under the License is distributed on an ""AS IS"" BASIS,
 * WITHOUT WARRANTIES OR CONDITIONS OF ANY KIND, either express or implied.
 * See the License for the specific language governing permissions and
 * limitations under the License.
 *
 * Please contact NeXTHub Corporation, 651 N Broad St, Suite 201, 
 * Middletown, DE 19709, New Castle County, USA.
 *
 */

// These are derived from N4100[fs.filesystem.synopsis], final draft for
// experimental filesystem.
SYMBOL(absolute, std::experimental::filesystem::, <experimental/filesystem>)
SYMBOL(canonical, std::experimental::filesystem::, <experimental/filesystem>)
SYMBOL(copy, std::experimental::filesystem::, <experimental/filesystem>)
SYMBOL(copy_file, std::experimental::filesystem::, <experimental/filesystem>)
SYMBOL(copy_options, std::experimental::filesystem::, <experimental/filesystem>)
SYMBOL(copy_symlink, std::experimental::filesystem::, <experimental/filesystem>)
SYMBOL(create_directories, std::experimental::filesystem::, <experimental/filesystem>)
SYMBOL(create_directory, std::experimental::filesystem::, <experimental/filesystem>)
SYMBOL(create_directory_symlink, std::experimental::filesystem::, <experimental/filesystem>)
SYMBOL(create_hard_link, std::experimental::filesystem::, <experimental/filesystem>)
SYMBOL(create_symlink, std::experimental::filesystem::, <experimental/filesystem>)
SYMBOL(current_path, std::experimental::filesystem::, <experimental/filesystem>)
SYMBOL(directory_entry, std::experimental::filesystem::, <experimental/filesystem>)
SYMBOL(directory_iterator, std::experimental::filesystem::, <experimental/filesystem>)
SYMBOL(directory_options, std::experimental::filesystem::, <experimental/filesystem>)
SYMBOL(equivalent, std::experimental::filesystem::, <experimental/filesystem>)
SYMBOL(exists, std::experimental::filesystem::, <experimental/filesystem>)
SYMBOL(file_size, std::experimental::filesystem::, <experimental/filesystem>)
SYMBOL(file_status, std::experimental::filesystem::, <experimental/filesystem>)
SYMBOL(file_time_type, std::experimental::filesystem::, <experimental/filesystem>)
SYMBOL(file_type, std::experimental::filesystem::, <experimental/filesystem>)
SYMBOL(filesystem_error, std::experimental::filesystem::, <experimental/filesystem>)
SYMBOL(hard_link_count, std::experimental::filesystem::, <experimental/filesystem>)
SYMBOL(is_block_file, std::experimental::filesystem::, <experimental/filesystem>)
SYMBOL(is_character_file, std::experimental::filesystem::, <experimental/filesystem>)
SYMBOL(is_directory, std::experimental::filesystem::, <experimental/filesystem>)
SYMBOL(is_empty, std::experimental::filesystem::, <experimental/filesystem>)
SYMBOL(is_fifo, std::experimental::filesystem::, <experimental/filesystem>)
SYMBOL(is_other, std::experimental::filesystem::, <experimental/filesystem>)
SYMBOL(is_regular_file, std::experimental::filesystem::, <experimental/filesystem>)
SYMBOL(is_socket, std::experimental::filesystem::, <experimental/filesystem>)
SYMBOL(is_symlink, std::experimental::filesystem::, <experimental/filesystem>)
SYMBOL(last_write_time, std::experimental::filesystem::, <experimental/filesystem>)
SYMBOL(path, std::experimental::filesystem::, <experimental/filesystem>)
SYMBOL(permissions, std::experimental::filesystem::, <experimental/filesystem>)
SYMBOL(perms, std::experimental::filesystem::, <experimental/filesystem>)
SYMBOL(read_symlink, std::experimental::filesystem::, <experimental/filesystem>)
SYMBOL(recursive_directory_iterator, std::experimental::filesystem::, <experimental/filesystem>)
SYMBOL(remove, std::experimental::filesystem::, <experimental/filesystem>)
SYMBOL(remove_all, std::experimental::filesystem::, <experimental/filesystem>)
SYMBOL(rename, std::experimental::filesystem::, <experimental/filesystem>)
SYMBOL(resize_file, std::experimental::filesystem::, <experimental/filesystem>)
SYMBOL(space, std::experimental::filesystem::, <experimental/filesystem>)
SYMBOL(space_info, std::experimental::filesystem::, <experimental/filesystem>)
SYMBOL(status, std::experimental::filesystem::, <experimental/filesystem>)
SYMBOL(status_known, std::experimental::filesystem::, <experimental/filesystem>)
SYMBOL(symlink_status, std::experimental::filesystem::, <experimental/filesystem>)
SYMBOL(system_complete, std::experimental::filesystem::, <experimental/filesystem>)
SYMBOL(temp_directory_path, std::experimental::filesystem::, <experimental/filesystem>)
SYMBOL(u8path, std::experimental::filesystem::, <experimental/filesystem>)
