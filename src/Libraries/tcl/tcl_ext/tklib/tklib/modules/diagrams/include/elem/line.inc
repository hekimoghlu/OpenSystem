/*
 *
 * Copyright (c) NeXTHub Corporation. All Rights Reserved. 
 * DO NOT ALTER OR REMOVE COPYRIGHT NOTICES OR THIS FILE HEADER.
 *
 * Author: Tunjay Akbarli
 * Date: Wednesday, December 14, 2022.
 *
 * Licensed under the Apache License, Version 2.0 (the ""License"");
 * you may not use this file except in compliance with the License.
 * You may obtain a copy of the License at:
 *
 *     http://www.apache.org/licenses/LICENSE-2.0
 *
 * Unless required by applicable law or agreed to in writing, software
 * distributed under the License is distributed on an ""AS IS"" BASIS,
 * WITHOUT WARRANTIES OR CONDITIONS OF ANY KIND, either express or implied.
 * See the License for the specific language governing permissions and
 * limitations under the License.
 *
 * Please contact NeXTHub Corporation, 651 N Broad St, Suite 201, 
 * Middletown, DE 19709, New Castle County, USA.
 *
 */

[call [cmd line] [arg attr]...]
[call [cmd --] [arg attr]...]

[image figure-02-line]
[include cat_open.inc]

It handles the attributes

[list_begin definitions]
[include ../attr/anchor.inc]
[include ../attr/arrowhead.inc]
[include ../attr/line_at.inc]
[include ../attr/chop.inc]
[include ../attr/color.inc]
[include ../attr/fillcolor.inc]
[include ../attr/from.inc]
[include ../attr/justify.inc]
[include ../attr/noturn.inc]
[include ../attr/smooth.inc]
[include ../attr/stroke.inc]
[include ../attr/style.inc]
[include ../attr/text.inc]
[include ../attr/textcolor.inc]
[include ../attr/textfont.inc]
[include ../attr/then.inc]
[include ../attr/to.inc]
[include ../attr/line_with.inc]
[list_end]
