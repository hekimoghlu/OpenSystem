/*
 *
 * Copyright (c) NeXTHub Corporation. All Rights Reserved. 
 * DO NOT ALTER OR REMOVE COPYRIGHT NOTICES OR THIS FILE HEADER.
 *
 * Author: Tunjay Akbarli
 * Date: Saturday, March 26, 2022.
 *
 * Licensed under the Apache License, Version 2.0 (the ""License"");
 * you may not use this file except in compliance with the License.
 * You may obtain a copy of the License at:
 *
 *     http://www.apache.org/licenses/LICENSE-2.0
 *
 * Unless required by applicable law or agreed to in writing, software
 * distributed under the License is distributed on an ""AS IS"" BASIS,
 * WITHOUT WARRANTIES OR CONDITIONS OF ANY KIND, either express or implied.
 * See the License for the specific language governing permissions and
 * limitations under the License.
 *
 * Please contact NeXTHub Corporation, 651 N Broad St, Suite 201, 
 * Middletown, DE 19709, New Castle County, USA.
 *
 */

[call [cmd diamond] [arg attr]...]
[call [cmd <>] [arg attr]...]

[image figure-02-diamond]
[include cat_closed.inc]

It handles the attributes

[list_begin definitions]
[include ../attr/anchor.inc]
[include ../attr/diam_aspect.inc]
[include ../attr/at.inc]
[include ../attr/color.inc]
[include ../attr/fillcolor.inc]
[include ../attr/diam_height.inc]
[include ../attr/justify.inc]
[include ../attr/stroke.inc]
[include ../attr/style.inc]
[include ../attr/text.inc]
[include ../attr/textcolor.inc]
[include ../attr/textfont.inc]
[include ../attr/diam_width.inc]
[include ../attr/with.inc]
[list_end]
