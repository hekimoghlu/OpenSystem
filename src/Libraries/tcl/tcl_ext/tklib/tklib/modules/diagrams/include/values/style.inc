/*
 *
 * Copyright (c) NeXTHub Corporation. All Rights Reserved. 
 * DO NOT ALTER OR REMOVE COPYRIGHT NOTICES OR THIS FILE HEADER.
 *
 * Author: Tunjay Akbarli
 * Date: Wednesday, July 26, 2023.
 *
 * Licensed under the Apache License, Version 2.0 (the ""License"");
 * you may not use this file except in compliance with the License.
 * You may obtain a copy of the License at:
 *
 *     http://www.apache.org/licenses/LICENSE-2.0
 *
 * Unless required by applicable law or agreed to in writing, software
 * distributed under the License is distributed on an ""AS IS"" BASIS,
 * WITHOUT WARRANTIES OR CONDITIONS OF ANY KIND, either express or implied.
 * See the License for the specific language governing permissions and
 * limitations under the License.
 *
 * Please contact NeXTHub Corporation, 651 N Broad St, Suite 201, 
 * Middletown, DE 19709, New Castle County, USA.
 *
 */


The legal values are all those accepted by
[uri \
     http://www.tcl.tk/man/tcl8.5/TkLib/GetDash.htm \
     Tk_GetDash],

and additionally all which are listed below:

[list_begin definitions]
[def "[const solid], empty string"]		Draw solid line.
[def "[const dash], [const dashed], [const -]"]	Draw a dashed line.
[def "[const dot], [const dotted], [const .]"]	Draw a dotted line.
[def "[const dash-dot], [const -.]"]	  	Draw a dash-dotted line
[def "[const dash-dot-dot], [const -..]"]	Draw a dash-dot-dotted line.
[list_end]
