/*
 *
 * Copyright (c) NeXTHub Corporation. All Rights Reserved. 
 * DO NOT ALTER OR REMOVE COPYRIGHT NOTICES OR THIS FILE HEADER.
 *
 * Author: Tunjay Akbarli
 * Date: Monday, September 26, 2022.
 *
 * Licensed under the Apache License, Version 2.0 (the ""License"");
 * you may not use this file except in compliance with the License.
 * You may obtain a copy of the License at:
 *
 *     http://www.apache.org/licenses/LICENSE-2.0
 *
 * Unless required by applicable law or agreed to in writing, software
 * distributed under the License is distributed on an ""AS IS"" BASIS,
 * WITHOUT WARRANTIES OR CONDITIONS OF ANY KIND, either express or implied.
 * See the License for the specific language governing permissions and
 * limitations under the License.
 *
 * Please contact NeXTHub Corporation, 651 N Broad St, Suite 201, 
 * Middletown, DE 19709, New Castle County, USA.
 *
 */

[comment {--- Keywords common to all packages in Parser Tools ---}]
[keywords {EBNF}]
[keywords {LL(k)}]
[keywords {PEG}]
[keywords {TDPL}]
[keywords {context-free languages}]
[keywords {expression}]
[keywords {grammar}]
[keywords {matching}]
[keywords {parser}]
[keywords {parsing expression grammar}]
[keywords {parsing expression}]
[keywords {push down automaton}]
[keywords {recursive descent}]
[keywords {state}]
[keywords {top-down parsing languages}]
[keywords {transducer}]
