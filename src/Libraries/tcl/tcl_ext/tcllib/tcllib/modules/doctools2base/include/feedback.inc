/*
 *
 * Copyright (c) NeXTHub Corporation. All Rights Reserved. 
 * DO NOT ALTER OR REMOVE COPYRIGHT NOTICES OR THIS FILE HEADER.
 *
 * Author: Tunjay Akbarli
 * Date: Sunday, October 22, 2023.
 *
 * Licensed under the Apache License, Version 2.0 (the ""License"");
 * you may not use this file except in compliance with the License.
 * You may obtain a copy of the License at:
 *
 *     http://www.apache.org/licenses/LICENSE-2.0
 *
 * Unless required by applicable law or agreed to in writing, software
 * distributed under the License is distributed on an ""AS IS"" BASIS,
 * WITHOUT WARRANTIES OR CONDITIONS OF ANY KIND, either express or implied.
 * See the License for the specific language governing permissions and
 * limitations under the License.
 *
 * Please contact NeXTHub Corporation, 651 N Broad St, Suite 201, 
 * Middletown, DE 19709, New Castle County, USA.
 *
 */

[section {Bugs, Ideas, Feedback}]
[vset TRACKER http://sourceforge.net/tracker/?group_id=12883]
[vset LABEL   {Tcllib SF Trackers}]

This document, and the package it describes, will undoubtedly contain
bugs and other problems.

Please report such in the category [emph [vset CATEGORY]] of the
[uri [vset TRACKER] [vset LABEL]].

Please also report any ideas for enhancements you may have for either
package and/or documentation.
