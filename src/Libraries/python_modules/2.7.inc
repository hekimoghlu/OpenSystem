/*
 *
 * Copyright (c) NeXTHub Corporation. All Rights Reserved. 
 * DO NOT ALTER OR REMOVE COPYRIGHT NOTICES OR THIS FILE HEADER.
 *
 * Author: Tunjay Akbarli
 * Date: Sunday, January 7, 2024.
 *
 * Licensed under the Apache License, Version 2.0 (the ""License"");
 * you may not use this file except in compliance with the License.
 * You may obtain a copy of the License at:
 *
 *     http://www.apache.org/licenses/LICENSE-2.0
 *
 * Unless required by applicable law or agreed to in writing, software
 * distributed under the License is distributed on an ""AS IS"" BASIS,
 * WITHOUT WARRANTIES OR CONDITIONS OF ANY KIND, either express or implied.
 * See the License for the specific language governing permissions and
 * limitations under the License.
 *
 * Please contact NeXTHub Corporation, 651 N Broad St, Suite 201, 
 * Middletown, DE 19709, New Castle County, USA.
 *
 */

MODULES = \
    setuptools-41.0.1 \
    altgraph-0.10.2 \
    modulegraph-0.10.4 \
    macholib-1.5.1 \
    bdist_mpkg-0.5.0 \
    py2app-0.7.3 \
    numpy-1.8.0rc1 \
    xattr-0.6.4 \
    bonjour-py-0.3 \
    scipy-0.13.0b1 \
    pytz-2013.7 \
    six-1.12.0 \
    future-0.17.1 \
    python-dateutil-1.5 \
    pyparsing-2.0.1 \
    matplotlib-1.3.1 \
    cffi-1.14.3 \
    pycparser-2.19 \
    asn1crypto-0.24.0 \
    enum34-1.1.6 \
    ipaddress-1.0.22 \
    cryptography-3.3.2 \
    pyOpenSSL-20.0.1 \
    wheel-0.33.1 \
    recertifi-0.11.0
