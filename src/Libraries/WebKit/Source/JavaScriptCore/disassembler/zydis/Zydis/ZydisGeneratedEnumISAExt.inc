/*
 *
 * Copyright (c) NeXTHub Corporation. All Rights Reserved. 
 * DO NOT ALTER OR REMOVE COPYRIGHT NOTICES OR THIS FILE HEADER.
 *
 * Author: Tunjay Akbarli
 * Date: Monday, June 26, 2023.
 *
 * Licensed under the Apache License, Version 2.0 (the ""License"");
 * you may not use this file except in compliance with the License.
 * You may obtain a copy of the License at:
 *
 *     http://www.apache.org/licenses/LICENSE-2.0
 *
 * Unless required by applicable law or agreed to in writing, software
 * distributed under the License is distributed on an ""AS IS"" BASIS,
 * WITHOUT WARRANTIES OR CONDITIONS OF ANY KIND, either express or implied.
 * See the License for the specific language governing permissions and
 * limitations under the License.
 *
 * Please contact NeXTHub Corporation, 651 N Broad St, Suite 201, 
 * Middletown, DE 19709, New Castle County, USA.
 *
 */

static const char* STR_ISAEXT[] =
{
    "INVALID",
    "ADOX_ADCX",
    "AES",
    "AMD3DNOW",
    "AMD3DNOW_PREFETCH",
    "AMD_INVLPGB",
    "AMX_BF16",
    "AMX_INT8",
    "AMX_TILE",
    "AVX",
    "AVX2",
    "AVX2GATHER",
    "AVX512EVEX",
    "AVX512VEX",
    "AVXAES",
    "AVX_VNNI",
    "BASE",
    "BMI1",
    "BMI2",
    "CET",
    "CLDEMOTE",
    "CLFLUSHOPT",
    "CLFSH",
    "CLWB",
    "CLZERO",
    "ENQCMD",
    "F16C",
    "FMA",
    "FMA4",
    "GFNI",
    "HRESET",
    "INVPCID",
    "KEYLOCKER",
    "KEYLOCKER_WIDE",
    "KNC",
    "KNCE",
    "KNCV",
    "LONGMODE",
    "LZCNT",
    "MCOMMIT",
    "MMX",
    "MONITOR",
    "MONITORX",
    "MOVBE",
    "MOVDIR",
    "MPX",
    "PADLOCK",
    "PAUSE",
    "PCLMULQDQ",
    "PCONFIG",
    "PKU",
    "PREFETCHWT1",
    "PT",
    "RDPID",
    "RDPRU",
    "RDRAND",
    "RDSEED",
    "RDTSCP",
    "RDWRFSGS",
    "RTM",
    "SERIALIZE",
    "SGX",
    "SGX_ENCLV",
    "SHA",
    "SMAP",
    "SMX",
    "SNP",
    "SSE",
    "SSE2",
    "SSE3",
    "SSE4",
    "SSE4A",
    "SSSE3",
    "SVM",
    "TBM",
    "TDX",
    "TSX_LDTRK",
    "UINTR",
    "VAES",
    "VMFUNC",
    "VPCLMULQDQ",
    "VTX",
    "WAITPKG",
    "X87",
    "XOP",
    "XSAVE",
    "XSAVEC",
    "XSAVEOPT",
    "XSAVES"
};
