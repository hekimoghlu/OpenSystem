/*
 *
 * Copyright (c) NeXTHub Corporation. All Rights Reserved. 
 * DO NOT ALTER OR REMOVE COPYRIGHT NOTICES OR THIS FILE HEADER.
 *
 * Author: Tunjay Akbarli
 * Date: Monday, July 4, 2022.
 *
 * Licensed under the Apache License, Version 2.0 (the ""License"");
 * you may not use this file except in compliance with the License.
 * You may obtain a copy of the License at:
 *
 *     http://www.apache.org/licenses/LICENSE-2.0
 *
 * Unless required by applicable law or agreed to in writing, software
 * distributed under the License is distributed on an ""AS IS"" BASIS,
 * WITHOUT WARRANTIES OR CONDITIONS OF ANY KIND, either express or implied.
 * See the License for the specific language governing permissions and
 * limitations under the License.
 *
 * Please contact NeXTHub Corporation, 651 N Broad St, Suite 201, 
 * Middletown, DE 19709, New Castle County, USA.
 *
 */

static const char* STR_INSTRUCTIONCATEGORY[] =
{
    "INVALID",
    "ADOX_ADCX",
    "AES",
    "AMD3DNOW",
    "AMX_TILE",
    "AVX",
    "AVX2",
    "AVX2GATHER",
    "AVX512",
    "AVX512_4FMAPS",
    "AVX512_4VNNIW",
    "AVX512_BITALG",
    "AVX512_VBMI",
    "AVX512_VP2INTERSECT",
    "BINARY",
    "BITBYTE",
    "BLEND",
    "BMI1",
    "BMI2",
    "BROADCAST",
    "CALL",
    "CET",
    "CLDEMOTE",
    "CLFLUSHOPT",
    "CLWB",
    "CLZERO",
    "CMOV",
    "COMPRESS",
    "COND_BR",
    "CONFLICT",
    "CONVERT",
    "DATAXFER",
    "DECIMAL",
    "ENQCMD",
    "EXPAND",
    "FCMOV",
    "FLAGOP",
    "FMA4",
    "FP16",
    "GATHER",
    "GFNI",
    "HRESET",
    "IFMA",
    "INTERRUPT",
    "IO",
    "IOSTRINGOP",
    "KEYLOCKER",
    "KEYLOCKER_WIDE",
    "KMASK",
    "KNC",
    "KNCMASK",
    "KNCSCALAR",
    "LEGACY",
    "LOGICAL",
    "LOGICAL_FP",
    "LZCNT",
    "MISC",
    "MMX",
    "MOVDIR",
    "MPX",
    "NOP",
    "PADLOCK",
    "PCLMULQDQ",
    "PCONFIG",
    "PKU",
    "POP",
    "PREFETCH",
    "PREFETCHWT1",
    "PT",
    "PUSH",
    "RDPID",
    "RDPRU",
    "RDRAND",
    "RDSEED",
    "RDWRFSGS",
    "RET",
    "ROTATE",
    "SCATTER",
    "SEGOP",
    "SEMAPHORE",
    "SERIALIZE",
    "SETCC",
    "SGX",
    "SHA",
    "SHIFT",
    "SMAP",
    "SSE",
    "STRINGOP",
    "STTNI",
    "SYSCALL",
    "SYSRET",
    "SYSTEM",
    "TBM",
    "TSX_LDTRK",
    "UFMA",
    "UINTR",
    "UNCOND_BR",
    "VAES",
    "VBMI2",
    "VEX",
    "VFMA",
    "VPCLMULQDQ",
    "VTX",
    "WAITPKG",
    "WIDENOP",
    "X87_ALU",
    "XOP",
    "XSAVE",
    "XSAVEOPT"
};
